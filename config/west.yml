## config/west.yml
```yaml
#
# ataraxia v1
#

manifest:
  remotes:
    - name: zmkfirmware
      url-base: https://github.com/zmkfirmware
    - name: miketronic
      url-base: https://github.com/miketronic
    - name: benzhou1
      url-base: https://github.com/benzhou1
    - name: nuovotaka
      url-base: https://github.com/nuovotaka

  projects:
    - name: zmk
      remote: zmkfirmware
      revision: v0.3
      import: app/west.yml
    - name: zmk-keyboards-ataraxia
      remote: benzhou1
      revision: ataraxia_v1_ben
    - name: zmk-pmw3610-driver-02
      remote: miketronic
      revision: e2a5c45dc7bcb9c7cca438da129140da1cce94c4
    - name: zmk-pointing-acceleration-alpha
      remote: miketronic
      revision: bc00c6f041381727a18f9ce420361bd590978ef3      

  self:
    path: config
```
